## conf/layer.conf
```bitbake
#
# Copyright (C) 2020 Wind River Systems, Inc.
#

# We have a conf and classes directory, add to BBPATH
BBPATH =. "${LAYERDIR}:"

# We have a packages directory, add to BBFILES
BSP_NXP_LS20XX_DERIVED ??=""
BBFILES += "${@bb.utils.contains('MACHINE', 'nxp-ls20xx ${BSP_NXP_LS20XX_DERIVED}', '${LAYERDIR}/recipes-*/*/*.bb', '', d)}"
BBFILES += "${@bb.utils.contains('MACHINE', 'nxp-ls20xx ${BSP_NXP_LS20XX_DERIVED}', '${LAYERDIR}/recipes-*/*/*.bbappend', '', d)}"

BBFILE_COLLECTIONS += "wr-nxp-ls20xx"
BBFILE_PATTERN_wr-nxp-ls20xx := "^${LAYERDIR}/"
BBFILE_PRIORITY_wr-nxp-ls20xx = "7"

# This should only be incremented on significant changes that will
# cause compatibility issues with other layers
LAYERVERSION_wr-nxp-ls20xx = "1"

LAYERDEPENDS_wr-nxp-ls20xx = "core wrlinux freescale-layer"

LAYERSERIES_COMPAT_wr-nxp-ls20xx = "thud wrl zeus"
```

## conf/machine/nxp-ls20xx.conf
```bitbake
#@TYPE: Machine
#@NAME: nxp-ls20xx
#@DESCRIPTION: nxp-ls20xx

DEFAULTTUNE = "aarch64"
require conf/machine/include/arm/arch-armv8.inc

MACHINE_FEATURES = "ext3 pci usbgadget usbhost vfat"

KERNEL_IMAGETYPE = "Image"
KERNEL_DEVICETREE = "freescale/fsl-ls2088a-rdb.dtb"

SERIAL_CONSOLES ?= "115200;ttyS0"
SERIAL_CONSOLES_CHECK ?= "${SERIAL_CONSOLES}"

IMAGE_FSTYPES += "tar.bz2"

# multilib support
MULTILIBS ?= "multilib:lib32"
DEFAULTTUNE_virtclass-multilib-lib32 ?= "armv7athf-neon"
EXTRA_IMAGECMD_jffs2 = "--pad --no-cleanmarkers --eraseblock=128"

MACHINE_EXTRA_RRECOMMENDS = " kernel-modules kernel-devicetree"
IMAGE_FSTYPES += "tar.bz2 wic wic.bmap"
WKS_FILE ?= "ls20xx-sdimage-bootpart.wks"
IMAGE_INSTALL_append = " kernel-devicetree kernel-image-image"
do_image_wic[depends] += "mtools-native:do_populate_sysroot dosfstools-native:do_populate_sysroot"
IMAGE_BOOT_FILES ?= " Image fsl-ls2088a-rdb.dtb"
```
